## main/Kconfig.projbuild
```kconfig
menu "ESP Robotics"

	config CYTRON_MDDS
		bool "Enable support for the cytron mdds series motor driver"
		help
			if enabled, Support for the cytron mdds series motor driver
			based on UART Mode.

	config CYTRON_LSA
		bool "Enable support for the cytron lsa 08 driver"
		help
			if enabled, Support for the cytron lsa 08 driver
			will be enabled.

	config ECONNECT_SPI
		bool "Econnect API based on SPI communication protocol"
		help
			If enable, Econnect API based on SPI communication protocol will be enabled.

	config ROTARY_ENCODER
		bool "Enable support for the rotary encoders"
		help
			if enabled, Support for the rotary encoders will be enabled.

	config MPU6XXX
		bool "Enable support for the MPU 6xxx series of IMU"
		help
			if enabled, support for the MPU 6xxx series of IMU will be enabled.
			NOTE: Currently only mpu6886 is supported.

	config PS_HID
		bool "Enable support for the PS controller API based on HID host interface"
		depends on SOC_BT_CLASSIC_SUPPORTED
		select BT_ENABLED
		select BT_CLASSIC_ENABLED
		select BT_SPP_ENABLED
		select BT_L2CAP_ENABLED
		select BT_HID_ENABLED
		select BT_HID_HOST_ENABLED
		help
			Enable support for the PS controller over hid API based on HID playstation.

endmenu
```
